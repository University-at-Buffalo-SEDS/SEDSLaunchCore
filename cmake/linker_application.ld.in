ENTRY(Reset_Handler)

PHDRS
{
  text PT_LOAD FLAGS(5);
  data PT_LOAD FLAGS(6);
}

MEMORY
{
  FIRMWARE_FLASH (rx)  : ORIGIN = @LC_vector_table@, LENGTH = @LC_firmware_size@
  FIRMWARE_RAM   (rwx) : ORIGIN = @LC_ram_base@, LENGTH = @LC_ram_size@
}

_estack = ORIGIN(FIRMWARE_RAM) + LENGTH(FIRMWARE_RAM);
_Min_Heap_Size = 0x200;
_Min_Stack_Size = 0x400;

SECTIONS
{
  .isr_vector : { . = ALIGN(4); KEEP(*(.isr_vector)); . = ALIGN(4); }
    > FIRMWARE_FLASH :text
  .text :
  {
    . = ALIGN(4);
    *(.text .text*) *(.glue_7 .glue_7t) *(.eh_frame)
    KEEP(*(.init)) KEEP(*(.fini))
    . = ALIGN(4); _etext = .;
  } > FIRMWARE_FLASH :text
  .rodata : { . = ALIGN(4); *(.rodata .rodata*) . = ALIGN(4); }
    > FIRMWARE_FLASH :text
  .ARM.extab : { *(.ARM.extab* .gnu.linkonce.armextab.*) }
    > FIRMWARE_FLASH :text
  .ARM :
  {
    __exidx_start = .; *(.ARM.exidx*) __exidx_end = .;
  } > FIRMWARE_FLASH :text
  .preinit_array :
  {
    PROVIDE_HIDDEN(__preinit_array_start = .);
    KEEP(*(.preinit_array*))
    PROVIDE_HIDDEN(__preinit_array_end = .);
  } > FIRMWARE_FLASH :text
  .init_array :
  {
    PROVIDE_HIDDEN(__init_array_start = .);
    KEEP(*(SORT(.init_array.*))) KEEP(*(.init_array*))
    PROVIDE_HIDDEN(__init_array_end = .);
  } > FIRMWARE_FLASH :text
  .fini_array :
  {
    PROVIDE_HIDDEN(__fini_array_start = .);
    KEEP(*(SORT(.fini_array.*))) KEEP(*(.fini_array*))
    PROVIDE_HIDDEN(__fini_array_end = .);
  } > FIRMWARE_FLASH :text

  _sidata = LOADADDR(.data);
  .data :
  {
    . = ALIGN(4); _sdata = .; *(.data .data*) *(.RamFunc .RamFunc*)
    . = ALIGN(4);
  } > FIRMWARE_RAM AT > FIRMWARE_FLASH :data
  .tdata : ALIGN(4)
  {
    *(.tdata .tdata.* .gnu.linkonce.td.*)
    . = ALIGN(4); _edata = .;
    PROVIDE(__data_end = .); PROVIDE(__tdata_end = .);
  } > FIRMWARE_RAM AT > FIRMWARE_FLASH :data
  PROVIDE(__tdata_start = ADDR(.tdata));
  PROVIDE(__tdata_size = __tdata_end - __tdata_start);
  PROVIDE(__data_start = ADDR(.data));
  PROVIDE(__data_size = __data_end - __data_start);
  PROVIDE(__tdata_source = LOADADDR(.tdata));
  PROVIDE(__tdata_source_end = LOADADDR(.tdata) + SIZEOF(.tdata));
  PROVIDE(__tdata_source_size = __tdata_source_end - __tdata_source);
  PROVIDE(__data_source = LOADADDR(.data));
  PROVIDE(__data_source_end = __tdata_source_end);
  PROVIDE(__data_source_size = __data_source_end - __data_source);
  .tbss (NOLOAD) : ALIGN(4)
  {
    _sbss = .; __bss_start__ = _sbss;
    *(.tbss .tbss.*) . = ALIGN(4); PROVIDE(__tbss_end = .);
  } > FIRMWARE_RAM :NONE
  PROVIDE(__tbss_start = ADDR(.tbss));
  PROVIDE(__tbss_size = __tbss_end - __tbss_start);
  PROVIDE(__tbss_offset = ADDR(.tbss) - ADDR(.tdata));
  PROVIDE(__tls_base = __tdata_start);
  PROVIDE(__tls_end = __tbss_end);
  PROVIDE(__tls_size = __tls_end - __tls_base);
  PROVIDE(__tls_align = MAX(ALIGNOF(.tdata), ALIGNOF(.tbss)));
  PROVIDE(__tls_size_align = (__tls_size + __tls_align - 1) & ~(__tls_align - 1));
  PROVIDE(__arm32_tls_tcb_offset = MAX(8, __tls_align));
  PROVIDE(__arm64_tls_tcb_offset = MAX(16, __tls_align));
  .bss (NOLOAD) : ALIGN(4)
  {
    *(.bss .bss*) *(COMMON)
    . = ALIGN(4); _ebss = .; __bss_end__ = _ebss; PROVIDE(__bss_end = .);
  } > FIRMWARE_RAM :NONE
  PROVIDE(__non_tls_bss_start = ADDR(.bss));
  PROVIDE(__bss_start = __tbss_start);
  PROVIDE(__bss_size = __bss_end - __bss_start);
  ._user_heap_stack (NOLOAD) :
  {
    . = ALIGN(8); PROVIDE(end = .); PROVIDE(_end = .);
    . = . + _Min_Heap_Size + _Min_Stack_Size; . = ALIGN(8);
  } > FIRMWARE_RAM :NONE
  /DISCARD/ : { *(.note.GNU-stack) }
}
